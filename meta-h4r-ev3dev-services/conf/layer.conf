## meta-h4r-ev3dev-services/conf/layer.conf
```bitbake
# We have a conf and classes directory, add to BBPATH
BBPATH .= ":${LAYERDIR}"

# We have recipes-* directories, add to BBFILES
BBFILES += "${LAYERDIR}/recipes-*/*/*.bb \
	${LAYERDIR}/recipes-*/*/*.bbappend"

BBFILE_COLLECTIONS += "meta-h4r-ev3dev-services"
BBFILE_PATTERN_meta-h4r-ev3dev-services = "^${LAYERDIR}/"
BBFILE_PRIORITY_meta-h4r-ev3dev-services = "6"
```

## meta-h4r-ev3dev/conf/layer.conf
```bitbake
# We have a conf and classes directory, add to BBPATH
BBPATH .= ":${LAYERDIR}"

# We have a recipes-* directories, add to BBFILES
BBFILES += "${LAYERDIR}/recipes-*/*/*.bb \
	${LAYERDIR}/recipes-*/*/*.bbappend"

BBFILE_COLLECTIONS += "meta-h4r-ev3dev"
BBFILE_PATTERN_meta-h4r-ev3dev = "^${LAYERDIR}/"
BBFILE_PRIORITY_meta-h4r-ev3dev = "6"
```

## meta-h4r-ev3dev/conf/machine/ev3dev.conf
```bitbake
#@TYPE: Machine
#@NAME: ev3dev
#@DESCRIPTION: EV3 Lego Brick


MACHINE_EXTRA_RRECOMMENDS = "kernel-modules"

EXTRA_IMAGEDEPENDS += "u-boot"

include conf/machine/include/tune-arm926ejs.inc
require conf/machine/include/omapl138.inc

IMAGE_FSTYPES += "tar.bz2 jffs2"
EXTRA_IMAGECMD_jffs2 = "-lnp "

#SERIAL_CONSOLE ?= "115200 ttyS1"
SERIAL_CONSOLE = ""

PREFERRED_PROVIDER_virtual/kernel ?= "linux-yocto-h4r-ev3"
PREFERRED_PROVIDER_virtual/bootloader = "u-boot"

UBOOT_MACHINE = "da850_am18xxevm_config"
UBOOT_SUFFIX = "ais"

UBOOT_ENTRYPOINT = "0xc0008000"
UBOOT_LOADADDRESS = "0xc0008000"

USE_VT="1"

KERNEL_IMAGETYPE = "uImage"
KERNEL_EXTRA_ARGS += "LOADADDR=${UBOOT_ENTRYPOINT}"
EXTRA_IMAGEDEPENDS += "u-boot"
EXTRA_IMAGECMD_jffs2 = "--pad --little-endian --eraseblock=0x20000 -n"

MACHINE_FEATURES = "kernel26 serial ethernet usbhost usbgadget mmc wifi bluetooth serial vfat alsa"
```
